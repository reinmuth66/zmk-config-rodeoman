## boards/shields/rodeoman/Kconfig.defconfig
```kconfig
if SHIELD_RODEOMAN_LEFT

config ZMK_KEYBOARD_NAME
    default "rodeoman"

config ZMK_SPLIT_ROLE_CENTRAL
    default y

endif

if SHIELD_RODEOMAN_LEFT || SHIELD_RODEOMAN_RIGHT

config ZMK_SPLIT
    default y

config SPI
    default y

config ZMK_POINTING
    default y

config AZ1UBALL
    default y

config I2C
    default y

endif
```

## boards/shields/rodeoman/Kconfig.shield
```kconfig
config SHIELD_RODEOMAN_LEFT
    def_bool $(shields_list_contains,rodeoman_left)

config SHIELD_RODEOMAN_RIGHT
    def_bool $(shields_list_contains,rodeoman_right)
```

## config/west.yml
```yaml
manifest:
  defaults:
    revision: v0.3
  remotes:
    - name: zmkfirmware
      url-base: https://github.com/zmkfirmware
    - name: reinmuth66
      url-base: https://github.com/reinmuth66
    - name: kzyz
      url-base: https://github.com/kzyz
  projects:
    - name: zmk
      remote: zmkfirmware
      import: app/west.yml
    - name: zmk_az1uball_driver
      remote: kzyz
      revision: main
    - name: zmk-rgbled-widget
      url: https://github.com/caksoylar/zmk-rgbled-widget
      revision: v0.3
  self:
    path: config
```
